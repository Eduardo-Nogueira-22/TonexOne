## main/Kconfig.projbuild
```kconfig
menu "Tonex Controller Configuration"

    choice TONEX_CONTROLLER_HARDWARE_PLATFORM
        prompt "Tonex Controller Hardware Platform"
        default TONEX_CONTROLLER_HARDWARE_PLATFORM_WAVESHARE_43B
    
        config TONEX_CONTROLLER_HARDWARE_PLATFORM_WAVESHARE_43B
            bool "Waveshare 4.3B"

        config TONEX_CONTROLLER_HARDWARE_PLATFORM_WAVESHARE_169
            bool "Waveshare 1.69"

        config TONEX_CONTROLLER_HARDWARE_PLATFORM_WAVESHARE_ZERO
            bool "Waveshare Zero"
            
        config TONEX_CONTROLLER_HARDWARE_PLATFORM_DEVKITC
            bool "Espressif DevKitC"
            
        config TONEX_CONTROLLER_HARDWARE_PLATFORM_M5ATOMS3R
            bool "M5Stack AtomS3R"            
    endchoice

    choice TONEX_CONTROLLER_SKINS
        prompt "Tonex Controller Skins included (applies to Display Type only)"
        default TONEX_CONTROLLER_SKINS_AMP
    
        config TONEX_CONTROLLER_SKINS_AMP
            bool "Amp Skins"

        config TONEX_CONTROLLER_SKINS_PEDAL
            bool "Pedal Skins"
    endchoice    

    config EXAMPLE_DOUBLE_FB
        bool "Use double Frame Buffer"
        default "n"
        help
            Enable this option, driver will allocate two frame buffers.

    config EXAMPLE_USE_BOUNCE_BUFFER
        depends on !EXAMPLE_DOUBLE_FB
        bool "Use bounce buffer"
        help
            Enable bounce buffer mode can achieve higher PCLK frequency at the cost of higher CPU consumption.

    config EXAMPLE_AVOID_TEAR_EFFECT_WITH_SEM
        depends on !EXAMPLE_DOUBLE_FB
        bool "Avoid tearing effect"
        default "y"
        help
            Enable this option, the example will use a pair of semaphores to avoid the tearing effect.
            Note, if the Double Frame Buffer is used, then we can also avoid the tearing effect without the lock.
            
endmenu
```
